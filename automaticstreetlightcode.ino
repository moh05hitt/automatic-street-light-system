#include <xc.h>
#include <stdio.h>
#define _XTAL_FREQ 8000000

#pragma config FOSC = HS, WDT = OFF, LVP = OFF, PBADEN = OFF, MCLRE = ON

#define LAMP LATBbits.LATB0
#define SDA LATBbits.LATB2
#define SCL LATBbits.LATB1

#define OLED_ADDR 0x78

// ---------------- Font Data (5x8 ASCII) ----------------
const unsigned char font5x8[][5] = {
{0x00,0x00,0x00,0x00,0x00}, // (space)
{0x00,0x00,0x5F,0x00,0x00}, // !
{0x00,0x07,0x00,0x07,0x00}, // "
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{0x61,0x51,0x49,0x45,0x43}  // Z
};

// -------------- I2C --------------
void I2C_Delay(void){ __delay_us(5); }
void I2C_Start(void){ SDA=1; SCL=1; I2C_Delay(); SDA=0; I2C_Delay(); SCL=0; }
void I2C_Stop(void){ SDA=0; SCL=1; I2C_Delay(); SDA=1; I2C_Delay(); }
void I2C_Write(unsigned char data){
    for(unsigned char i=0;i<8;i++){
        SDA=(data&0x80)?1:0;
        SCL=1; I2C_Delay();
        SCL=0; I2C_Delay();
        data<<=1;
    }
    SDA=1; SCL=1; I2C_Delay(); SCL=0;
}

// -------------- OLED --------------
void OLED_Command(unsigned char cmd){
    I2C_Start(); I2C_Write(OLED_ADDR); I2C_Write(0x00); I2C_Write(cmd); I2C_Stop();
}
void OLED_Data(unsigned char data){
    I2C_Start(); I2C_Write(OLED_ADDR); I2C_Write(0x40); I2C_Write(data); I2C_Stop();
}
void OLED_Init(void){
    __delay_ms(100);
    OLED_Command(0xAE); OLED_Command(0xD5); OLED_Command(0x80);
    OLED_Command(0xA8); OLED_Command(0x3F); OLED_Command(0xD3); OLED_Command(0x00);
    OLED_Command(0x40); OLED_Command(0x8D); OLED_Command(0x14);
    OLED_Command(0x20); OLED_Command(0x00); OLED_Command(0xA1);
    OLED_Command(0xC8); OLED_Command(0xDA); OLED_Command(0x12);
    OLED_Command(0x81); OLED_Command(0x7F); OLED_Command(0xA4);
    OLED_Command(0xA6); OLED_Command(0xAF);
}
void OLED_Clear(void){
    for(unsigned char p=0;p<8;p++){
        OLED_Command(0xB0+p); OLED_Command(0x00); OLED_Command(0x10);
        for(unsigned char i=0;i<128;i++) OLED_Data(0x00);
    }
}
void OLED_SetCursor(unsigned char x,unsigned char y){
    OLED_Command(0xB0+y);
    OLED_Command(((x&0xF0)>>4)|0x10);
    OLED_Command((x&0x0F)|0x00);
}
void OLED_Print(const char *str){
    while(*str){
        unsigned char c=*str;
        if(c<32||c>90) c=' ';
        for(unsigned char i=0;i<5;i++) OLED_Data(font5x8[c-32][i]);
        OLED_Data(0x00);
        str++;
    }
}

// -------------- ADC --------------
void ADC_Init(void){ ADCON1=0x0E; ADCON2=0x92; ADCON0=0x01; }
unsigned int ADC_Read(unsigned char ch){
    ADCON0 &= 0xC5; ADCON0 |= (ch<<3); __delay_ms(2);
    GO_nDONE=1; while(GO_nDONE);
    return ((ADRESH<<8)|ADRESL);
}

// -------------- MAIN --------------
void main(void){
    unsigned int ldr; unsigned char last=0xFF;
    TRISA=0xFF; TRISB=0x00; LATB=0x00;
    ADC_Init(); OLED_Init(); OLED_Clear();

    while(1){
        ldr=ADC_Read(0);
        unsigned char state = (ldr>512)?1:0;
        if(state!=last){
            OLED_Clear();
            OLED_SetCursor(0,0);
            if(state) OLED_Print("Nighttime");
            else OLED_Print("Daytime");
            OLED_SetCursor(0,2);
            if(state){ OLED_Print("Lamp: ON"); LAMP=1; }
            else { OLED_Print("Lamp: OFF"); LAMP=0; }
            last=state;
        }
        __delay_ms(200);
    }
}void setup() {
  // put your setup code here, to run once:

}

void loop() {
  // put your main code here, to run repeatedly:

}
